/*
 * Copyright (c) 2023 The ZMK Contributors
 *
 * SPDX-License-Identifier: MIT
 */

/ {
    /omit-if-no-ref/ pixel: animation_pixel {
        compatible = "zmk,animation-pixel";
        label = "PIXEL";
        #pixel-cells = <2>;
    };
};
