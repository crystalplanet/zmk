## app/boards/arm/orion_92/Kconfig.board
```kconfig
# Copyright (c) 2021 Kuba Birecki
# SPDX-License-Identifier: MIT

config BOARD_ORION_92
	bool "orion_92_board"
	depends on SOC_NRF52840_QIAA
```

## app/boards/arm/orion_92/Kconfig.defconfig
```kconfig
# Copyright (c) 2021 Kuba Birecki
# SPDX-License-Identifier: MIT

# Orion 92 keyboard configuration

if BOARD_ORION_92

config ZMK_KEYBOARD_NAME
	default "Orion 92"

if USB

config USB_NRFX
	default y

config USB_DEVICE_STACK
	default y

endif # USB

config BT_CTLR
	default BT

config ZMK_BLE
	default y

config ZMK_BATTERY_VOLTAGE_DIVIDER
	default y

config ZMK_KSCAN_MATRIX_POLLING
	default y

config ZMK_USB
	default y

endif # BOARD_ORION_92
```

## app/boards/arm/orion_92/orion_92_defconfig
```kconfig
# Copyright (c) 2021 Kuba Birecki
# SPDX-License-Identifier: MIT

# Board definition
CONFIG_SOC_SERIES_NRF52X=y
CONFIG_SOC_NRF52840_QIAA=y
CONFIG_BOARD_ORION_92=y

# Enable MPU
CONFIG_ARM_MPU=y

# Enable code partitions
CONFIG_USE_DT_CODE_PARTITION=y

# Enable flash
CONFIG_MPU_ALLOW_FLASH_WRITE=y
CONFIG_NVS=y
CONFIG_SETTINGS_NVS=y
CONFIG_FLASH=y
CONFIG_FLASH_PAGE_LAYOUT=y
CONFIG_FLASH_MAP=y

# Enable I2C
CONFIG_I2C=y
CONFIG_I2C_0=y

# Enable GPIO
CONFIG_GPIO=y

# Enable reset pin
CONFIG_GPIO_AS_PINRESET=y

# Set NFC pins to GPIO
CONFIG_NFCT_PINS_AS_GPIOS=y

# Enable USB
CONFIG_USB=y

# ZMK Features
CONFIG_ZMK_SLEEP=y

# CONFIG_ZMK_RGB_UNDERGLOW=y
CONFIG_IS31FL3741=y

CONFIG_ZMK_USB_LOGGING=y

CONFIG_LOG=y
CONFIG_PRINTK=y
CONFIG_CONSOLE=y

# CONFIG_STDOUT_CONSOLE=y

# CONFIG_UART_CONSOLE=n
# CONFIG_RTT_CONSOLE=y
# CONFIG_USE_SEGGER_RTT=y

# CONFIG_LOG_BACKEND_RTT_BUFFER_SIZE=16384

# CONFIG_ZMK_LOG_LEVEL=4
```

## app/drivers/sensor/Kconfig
```kconfig
# Copyright (c) 2020 The ZMK Contributors
# SPDX-License-Identifier: MIT

rsource "battery_voltage_divider/Kconfig"
rsource "cy8cmbr3106s/Kconfig"
rsource "ec11/Kconfig"
```

## app/drivers/sensor/cy8cmbr3106s/Kconfig
```kconfig
# Copyright (c) 2020 The ZMK Contributors
# SPDX-License-Identifier: MIT

config CY8CMBR3106S
	bool "CY8CMBR3106S Touch Controller"
	depends on I2C
	help
		Enable a CY8CMBR3106S Touch Controller.

			The CY8CMBR3xxx CapSense ExpressTM controllers enable advanced,
			yet easy-to-implement, user interface solutions using capacitive
			touch sensing.
```

## app/dts/bindings/behaviors/zmk,behavior-animation.yaml
```yaml
# Copyright (c) 2023 The ZMK Contributors
# SPDX-License-Identifier: MIT

description: Animation Action

compatible: "zmk,behavior-animation"

include: one_param.yaml
```

## app/dts/bindings/sensor/cypress,cy8cmbr3106s.yaml
```yaml
# Copyright (c) 2020, The ZMK Contributors
# SPDX-License-Identifier: MIT

description: Cypress CY8CMBR3106s Touch COntroller

compatible: "cypress,cy8cmbr3106s"

include: i2c-device.yaml

properties:
  trigger-gpios:
    type: phandle-array
    required: true
    description: |
      GPIO pin for hardware shutdown functionality.
```

## app/dts/bindings/zmk,animation-pixel.yaml
```yaml
# Copyright (c) 2023, The ZMK Contributors
# SPDX-License-Identifier: MIT

description: Pixel configuration

compatible: "zmk,animation-pixel"

pixel-cells:
  - position_x
  - position_y
```

## app/dts/bindings/zmk,touch-slider.yaml
```yaml
description: |
  Defines a touch slider.

compatible: "zmk,touch_slider"

properties:
  sensor:
    type: phandle
    required: true
```
